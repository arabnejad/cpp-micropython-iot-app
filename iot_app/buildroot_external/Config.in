## iot_app/buildroot_external/Config.in
```kconfig
menu "IoT project packages"
source "$BR2_EXTERNAL_IOT_PROJECT_PATH/package/iot_app/Config.in"
endmenu
```

## iot_app/buildroot_external/package/iot_app/Config.in
```kconfig
config BR2_PACKAGE_IOT_APP
	bool "iot_app"
	depends on BR2_INSTALL_LIBSTDCPP
	depends on BR2_TOOLCHAIN_HAS_THREADS
	select BR2_PACKAGE_LIBDRM
	select BR2_PACKAGE_LIBDRM_VC4 if BR2_arm || BR2_aarch64
	help
	  Embedded C++ IoT App with a built-in MicroPython application,
	  native hardware modules, DRM display discovery, and LVGL Linux
	  framebuffer output.
```
